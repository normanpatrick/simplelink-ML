// These arguments were used when this file was generated. They will be automatically applied on subsequent loads 
// via the GUI or CLI invocations. Run CLI with '--help' for additional information on how to override these arguments.
// @cliArgs --board "/ti/boards/CC1352P1_LAUNCHXL" --product "simplelink_cc13x2_26x2_sdk@3.30.00.03"
// @versions {"data":"2019083011","timestamp":"2019083011","tool":"1.2.952","templates":"2019083011"}

var RTOS = scripting.addModule("/ti/drivers/RTOS");
var PWM = scripting.addModule("/ti/drivers/PWM");
var PWM1 = PWM.addInstance();
var Power = scripting.addModule("/ti/drivers/Power");
var CCFG = scripting.addModule("/ti/devices/CCFG");
var Board = scripting.addModule("/ti/drivers/Board");
var DriverLib = scripting.addModule("/ti/devices/DriverLib");
var PWM2 = PWM.addInstance();
var GPIO = scripting.addModule("/ti/drivers/GPIO");
var GPIO1 = GPIO.addInstance();
var UART = scripting.addModule("/ti/drivers/UART");
var UART1 = UART.addInstance();
// Name - The C/C++ identifier used in applications as the index parameter passed to PWM runtime APIs
PWM1.$name = "CONFIG_PWM_0";
// Use Hardware - Select the hardware to use, or 'None' to use available header pins
PWM1.$hardware = system.deviceData.board.components.LED_RED;
// Name - The C/C++ identifier used in applications as the index parameter passed to GPTimerCC26XX runtime APIs
PWM1.timerObject.$name = "CONFIG_GPTIMER_0";
// Name
PWM1.timerObject.timer.$name = "MyGPTM1";
// Name
PWM1.timerObject.pwmPinInstance.$name = "CONFIG_PIN_0";
// Name
CCFG.ccfgTemplate.$name = "ti_devices_CCFGTemplate0";
// Name - The C/C++ identifier used in applications as the index parameter passed to PWM runtime APIs
PWM2.$name = "CONFIG_PWM_1";
// Use Hardware - Select the hardware to use, or 'None' to use available header pins
PWM2.$hardware = system.deviceData.board.components.LED_GREEN;
// Name - The C/C++ identifier used in applications as the index parameter passed to GPTimerCC26XX runtime APIs
PWM2.timerObject.$name = "CONFIG_GPTIMER_1";
// Name
PWM2.timerObject.timer.$name = "MyGPTM1";
// Name
PWM2.timerObject.pwmPinInstance.$name = "CONFIG_PIN_1";
// Use Hardware - Select the hardware to use, or 'None' to use available header pins
GPIO1.$hardware = system.deviceData.board.components["BTN-1"];
// Name - The C/C++ identifier used in applications as the index parameter passed to GPIO runtime APIs
GPIO1.$name = "CONFIG_GPIO_BUTTON_1";
// Name
GPIO1.pinInstance.$name = "CONFIG_PIN_2";
// Name - The C/C++ identifier used in applications as the index parameter passed to UART runtime APIs
UART1.$name = "CONFIG_UART_0";
// Use Hardware - Select the hardware to use, or 'None' to use available header pins
UART1.$hardware = system.deviceData.board.components.XDS110UART;
// Name
UART1.txPinInstance.$name = "CONFIG_PIN_3";
// Name
UART1.rxPinInstance.$name = "CONFIG_PIN_4";
// Name
UART1.uart.$name = "MyUART1";
// Suggest solution
PWM1.timerObject.timer.$suggestSolution = "GPTM1";
// Suggest solution
PWM1.timerObject.timer.pwmPin.$suggestSolution = "11";
// Suggest solution
PWM2.timerObject.timer.$suggestSolution = "GPTM1";
// Suggest solution
PWM2.timerObject.timer.pwmPin.$suggestSolution = "12";
// Suggest solution
GPIO1.gpioPin.$suggestSolution = "21";
// Suggest solution
UART1.uart.$suggestSolution = "UART0";
// Suggest solution
UART1.uart.txPin.$suggestSolution = "19";
// Suggest solution
UART1.uart.rxPin.$suggestSolution = "18";
